## boards/shields/pteron36_unibody/Kconfig.defconfig
```kconfig
if SHIELD_PTERON36_UNIBODY

config ZMK_KEYBOARD_NAME
    default "Pteron36 Uni"

endif
```

## boards/shields/pteron36_unibody/Kconfig.shield
```kconfig
# No whitespace after the comma or in your keyboard name!
config SHIELD_PTERON36_UNIBODY_DONGLE
    def_bool $(shields_list_contains,pteron36_unibody_dongle)
```
